## Kconfig
```kconfig
#
# Copyright 2015, NICTA
#
# This software may be distributed and modified according to the terms of
# the BSD 2-Clause license. Note that NO WARRANTY is provided.
# See "LICENSE_BSD2.txt" for details.
#
# @TAG(NICTA_BSD)
#

menuconfig APP_TEE_OS
    bool "seL4 TEE"
    default n
    depends on LIB_SEL4 && (LIB_MUSL_C || LIB_SEL4_C) && LIB_SEL4_SIMPLE && LIB_SEL4_VKA && LIB_SEL4_ALLOCMAN && LIB_SEL4_VSPACE && LIB_SEL4_PLAT_SUPPORT && LIB_SEL4_UTILS && LIB_CPIO && LIB_ELF && LIB_UTILS
    help
       seL4 TEE-OS
```
